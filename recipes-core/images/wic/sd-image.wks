## recipes-core/images/wic/sd-image.wks
```
part /boot --source bootimg-partition --ondisk mmcblk0 --fstype=vfat --label boot --active --align 4096 --size 32

part / --source rootfs --ondisk mmcblk0 --fstype=ext4 --label root --align 4096 --size 2G

part --source rootfs --ondisk mmcblk0 --fstype=ext4 --label root2 --align 4096 --size 2G

part --fstype=ext4 --ondisk mmcblk0 --label data --align 4096 --size 24G
```
